## package/Config.in
```kconfig
menu "Interpreter languages and scripting"
	source "$BR2_EXTERNAL_ELEBIHAN_PATH/package/chibi-scheme/Config.in"
	source "$BR2_EXTERNAL_ELEBIHAN_PATH/package/chicken/Config.in"
endmenu

menu "Libraries"

menu "Crypto"
	source "$BR2_EXTERNAL_ELEBIHAN_PATH/package/bearssl/Config.in"
endmenu

endmenu

if BR2_PACKAGE_PYTHON || BR2_PACKAGE_PYTHON3
menu "External python modules"
	source "$BR2_EXTERNAL_ELEBIHAN_PATH/package/python-scapy/Config.in"
endmenu
endif
```

## package/Config.in.host
```kconfig
menu "Host utilities"
	source "$BR2_EXTERNAL_ELEBIHAN_PATH/package/python-pykcs11/Config.in.host"
endmenu
```

## package/bearssl/Config.in
```kconfig
config BR2_PACKAGE_BEARSSL
	bool "bearssl"
	help
	  BearSSL is an implementation of the SSL/TLS protocol
	  (RFC 5246) written in C. It aims at offering the following
	  features:

	  - Be correct and secure.
	  - Be small, both in RAM and code footprint.
	  - Be highly portable
	  - Be feature-rich and extensible.

	  https://www.bearssl.org

if BR2_PACKAGE_BEARSSL

config BR2_PACKAGE_BEARSSL_BIN
	bool "brssl binary"
	help
	  Install brssl, a command-line tool which can exercise some of
	  the functionalities of BearSSL, in particular running a test
	  SSL client or server. It is not meant for production purposes.

endif
```

## package/chibi-scheme/Config.in
```kconfig
config BR2_PACKAGE_CHIBI_SCHEME
	bool "chibi-scheme"
	help
	  Minimal Scheme Implementation for use as an Extension Language.

	  http://synthcode.com/wiki/chibi-scheme

if BR2_PACKAGE_CHIBI_SCHEME

config BR2_PACKAGE_CHIBI_SCHEME_REPL
	bool "Install interpreter"
	default n
	help
	  Install command line REPL on target

endif
```

## package/chicken/Config.in
```kconfig
config BR2_PACKAGE_CHICKEN
	bool "chicken"
	help
	  Chicken is a practical and portable Scheme system.

	  http://code.call-cc.org/

if BR2_PACKAGE_CHICKEN

config BR2_PACKAGE_CHICKEN_REPL
	bool "Install interpreter"
	default n
	help
	  Install interactive interpreter

endif
```

## package/python-pykcs11/Config.in.host
```kconfig
config BR2_PACKAGE_HOST_PYTHON_PYKCS11
	bool "host-python-pykcs11"
	help
	  Full PKCS#11 Python wrapper

	  https://sourceforge.net/projects/pkcs11wrap/
```

## package/python-scapy/Config.in
```kconfig
config BR2_PACKAGE_PYTHON_SCAPY
	bool "python-scapy"
	depends on BR2_PACKAGE_PYTHON
	help
	  Scapy is a powerful interactive packet manipulation program.
	  It is able to forge or decode packets of a wide number of protocols,
	  send them on the wire, capture them, match requests and replies, and
	  much more.

	  http://www.secdev.org/projects/scapy/
```

## package/wolfssl/Config.in
```kconfig
config BR2_PACKAGE_WOLFSSL
	bool "wolfssl"
	help
	  wolfSSL (formerly CyaSSL) is a small, fast, portable
	  implementation of TLS/SSL for embedded devices to the cloud.

	  http://www.wolfssl.com
```
